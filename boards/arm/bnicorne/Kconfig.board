## boards/arm/bnicorne/Kconfig.board
```kconfig
#
# Copyright (c) 2024 Kyle Brown
# SPDX-License-Identifier: MIT
#

config BOARD_BNICORNE_LEFT
    bool "blecorne left"
    depends on SOC_NRF52840_QIAA

config BOARD_BNICORNE_RIGHT
    bool "blecorne right"
    depends on SOC_NRF52840_QIAA
```

## boards/arm/bnicorne/Kconfig.defconfig
```kconfig
#
# Copyright (c) 2024 Kyle Brown
# SPDX-License-Identifier: MIT
#

if BOARD_BNICORNE_LEFT

config ZMK_KEYBOARD_NAME
    default "BLECORNE"

config ZMK_SPLIT_ROLE_CENTRAL
    default y

endif # BOARD_BNICORNE_LEFT


if BOARD_BNICORNE_LEFT || BOARD_BNICORNE_RIGHT

config BOARD
    default "blecorne"

config ZMK_SPLIT
    default y

config BT_CTLR
    default BT

if USB

config USB_NRFX
    default y

config USB_DEVICE_STACK
    default y

endif # USB

config ZMK_DISPLAY
    select LV_USE_CONT
    select LV_FONT_MONTSERRAT_26
    select LV_FONT_MONTSERRAT_16
    select LV_USE_LABEL
    select LV_USE_IMG

choice ZMK_DISPLAY_STATUS_SCREEN
    default ZMK_DISPLAY_STATUS_SCREEN_CUSTOM
endchoice

if ZMK_DISPLAY

config SPI
    default y


config ZMK_DISPLAY_BLANK_ON_IDLE
    default n


endif # ZMK_DISPLAY

menuconfig CUSTOM_WIDGET_BATTERY_STATUS
    bool "custom battery status widget"

menuconfig CUSTOM_WIDGET_OUTPUT_STATUS
    bool "custom output status widget"

menuconfig CUSTOM_WIDGET_LAYER_STATUS
    bool "custom layer status widget"

menuconfig CUSTOM_WIDGET_PERIPHERAL_STATUS
    bool "custom peripheral status widget"

endif # BOARD_BNICORNE_LEFT || BOARD_BNICORNE_RIGHT
```
